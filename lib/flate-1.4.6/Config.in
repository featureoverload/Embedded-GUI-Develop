## lib/flate-1.4.6/Config.in
```kconfig
config BR2_PACKAGE_LIBFLATE
        bool "libflate"
        default n
        help
          Flate is a template library used to deal with html code in CGI applications.
```
